// Device tree overlay for Uctronics AI in a Box audio codec.
//
// Hardware: custom Useful Sensors "uctronics-codec" — a class-D speaker
// amp (sdmode + 3-bit gain GPIOs) and a MEMS I2S microphone wrapped
// into one ALSA sound card via the rockchip,multicodecs-card framework.
//
// Pairs with the out-of-tree snd-soc-uctronics-codec.ko module
// (see Makefile + snd-soc-uctronics-codec.c in this directory).
//
// Target kernel: Armbian 6.1.115-vendor-rk35xx on Rock 5A.
// See docs/09_AUDIO.md for hardware analysis and reverse-engineering
// notes — in particular the warning about NOT setting clk-trcm or
// /delete-property/ trcm-sync-tx-only here; those broke boot twice.

/dts-v1/;
/plugin/;

/ {
	compatible = "radxa,rock-5a", "rockchip,rk3588s", "rockchip,rk3588";

	fragment@0 {
		target-path = "/";
		__overlay__ {
			audio_codec_0: audio-codec-0 {
				compatible = "uctronics,uctronics-codec";

				// Speaker amp enable + 3-bit gain selector GPIOs.
				// Without these the codec driver leaves the gain
				// pins floating and DAC Playback Volume is a no-op.
				//
				// NOTE: these are on GPIO bank 1, NOT bank 3.
				// docs/09_AUDIO.md and the snd-soc-uctronics-codec.c
				// header used to say GPIO3 — that was a misread of
				// the baseline DT (phandle 0x16a is gpio@fec20000 =
				// GPIO1, not gpio@fec40000 = GPIO3). Two earlier
				// boot hangs traced to the GPIO3 misassignment.
				// See docs/TROUBLESHOOTING.md.
				sdmode-gpios    = <&gpio1 13 0>; /* GPIO1_B5 */
				gainsel_1-gpios = <&gpio1  3 0>; /* GPIO1_A3 — MSB */
				gainsel_2-gpios = <&gpio1  5 0>; /* GPIO1_A5 — mid */
				gainsel_3-gpios = <&gpio1  2 0>; /* GPIO1_A2 — LSB */

				// Mid-range default: vol 2 ≈ +12 dB. Adjust at
				// runtime with `amixer -c 1 cset numid=12 N`
				// (0–4; 4 is the loudest = ~+18 dB).
				default-volume = <2>;

				#sound-dai-cells = <0>;
				status = "okay";
			};

			uctronics-sound {
				compatible = "rockchip,multicodecs-card";
				rockchip,card-name = "uctronics-codec";
				rockchip,format = "i2s";
				rockchip,mclk-fs = <256>;
				rockchip,cpu = <&i2s1_8ch>;
				rockchip,codec = <&audio_codec_0>;
				status = "okay";
			};
		};
	};

	// Enable I2S1_8CH (disabled by default in Armbian). We deliberately
	// keep this fragment minimal — DO NOT add rockchip,clk-trcm here or
	// /delete-property/ rockchip,trcm-sync-tx-only. Two earlier attempts
	// to do so hung systemd at boot (no networking, no getty) and forced
	// SD-card recovery. The mic works fine without the clock-mode change
	// once we capture at S32_LE 48 kHz — see docs/09_AUDIO.md.
	//
	// pinctrl-0 must be set explicitly: the originally-deployed working
	// overlay listed all four groups (LRCK, SCLK, SDI0 for mic, SDO0 for
	// speaker) and dropping them from a later iteration hung boot. See
	// docs/TROUBLESHOOTING.md.
	fragment@1 {
		target = <&i2s1_8ch>;
		__overlay__ {
			status = "okay";
			rockchip,playback-channels = <2>;
			rockchip,capture-channels = <2>;
			pinctrl-names = "default";
			pinctrl-0 = <&i2s1m0_lrck &i2s1m0_sclk
				     &i2s1m0_sdi0 &i2s1m0_sdo0>;
		};
	};
};
